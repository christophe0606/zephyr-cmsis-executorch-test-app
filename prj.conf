## CMakeLists.txt
```
# SPDX-License-Identifier: Apache-2.0

cmake_minimum_required(VERSION 3.20.0)

# The AI layer adds its Kconfig fragments before Zephyr processes configuration.
add_subdirectory(ai_layer)

# Include the NPU node even when an older build cache has an empty overlay list.
if(NOT DTC_OVERLAY_FILE)
  set(DTC_OVERLAY_FILE "${CMAKE_CURRENT_SOURCE_DIR}/app.overlay")
endif()

find_package(Zephyr REQUIRED HINTS $ENV{ZEPHYR_BASE})
project(my_app)

target_sources(app PRIVATE
  src/main.c
  src/arm_embedded_module.cpp
  src/executorch_test.cpp
)

# Keep runtime logging consistent with the existing AI layer configuration.
zephyr_compile_definitions(ET_LOG_ENABLED=0)
```

## prj.conf
```kconfig
# M55_HP boot address used by the board's existing Alif boot configuration.
CONFIG_USE_DT_CODE_PARTITION=n
CONFIG_FLASH_LOAD_OFFSET=0x200000

# E8 NPU-HG: Ethos-U85 with 256 MACs per cycle.
CONFIG_ETHOS_U=y
CONFIG_ETHOS_U85_256=y
CONFIG_ETHOS_U_ARM=y
#CONFIG_ETHOS_U_LOG_LEVEL_NONE=y

# Ethos-U synchronization uses the kernel heap.
CONFIG_HEAP_MEM_POOL_SIZE=16384
CONFIG_LOG=y
# Keep the boot banner and kernel logs in order with the runtime's direct printf.
CONFIG_LOG_MODE_IMMEDIATE=y
CONFIG_ETHOS_U_LOG_LEVEL_INF=y
CONFIG_CACHE_MANAGEMENT=y
CONFIG_ETHOS_U_DCACHE=y

CONFIG_CPP=y
CONFIG_STD_CPP17=y

# Runtime loading uses C++ containers; the runner also prints float logits.
CONFIG_MAIN_STACK_SIZE=16384
CONFIG_REQUIRES_FLOAT_PRINTF=y
```

## operators.conf
```kconfig
# ExecuTorch operator families required by the application.
CONFIG_CMSIS_EXECUTORCH_OP_QUANTIZED_QUANTIZE=y
CONFIG_CMSIS_EXECUTORCH_OP_QUANTIZED_DEQUANTIZE=y
```

## app.overlay
```dts
/* SPDX-License-Identifier: Apache-2.0 */

/ {
	/* Alif Ensemble 2.2.1: NPU_HG_BASE and M55_HP IRQ366 (Ethos-U85). */
	ethosu0: npu@49042000 {
		compatible = "arm,ethos-u";
		reg = <0x49042000 0x2000>;
		interrupt-parent = <&nvic>;
		interrupts = <366 2>;
		secure-enable;
		privilege-enable;
		status = "okay";
	};
};
```

## src/main.c
```c
/*
 * Copyright (c) 2012-2014 Wind River Systems, Inc.
 *
 * SPDX-License-Identifier: Apache-2.0
 */

#include <errno.h>
#include <inttypes.h>
#include <stdio.h>

#include <zephyr/device.h>
#include <zephyr/devicetree.h>

#include <ethosu_driver.h>

#include "executorch_test.h"

#define NPU_NODE DT_NODELABEL(ethosu0)

int main(void)
{
	const struct device *npu = DEVICE_DT_GET(NPU_NODE);
	struct ethosu_driver_version version;
	struct ethosu_hw_info hw;
	struct ethosu_driver *drv;
	int ret = 0;

	printf("Hello World! %s\n", CONFIG_BOARD_TARGET);
	printf("Ethos-U85 (NPU-HG) driver communication check\n");
	printf("Device: %s, base: 0x%08" PRIxPTR ", IRQ: %u\n", npu->name,
	       (uintptr_t)DT_REG_ADDR(NPU_NODE), DT_IRQN(NPU_NODE));

	ethosu_get_driver_version(&version);
	printf("Driver version: %u.%u.%u\n", version.major, version.minor, version.patch);

	/* Do not reserve a driver if initialization failed: reservation would block. */
	if (!device_is_ready(npu)) {
		printf("ERROR: Ethos-U85 device initialization failed. Check the driver logs "
		       "and the board's NPU power, clock and security configuration.\n");
		return -ENODEV;
	}

	drv = ethosu_reserve_driver();
	if (drv == NULL) {
		printf("ERROR: Could not reserve the Ethos-U85 driver.\n");
		return -ENODEV;
	}

	/* This API reads the NPU's ID and CONFIG registers through the core driver. */
	ethosu_get_hw_info(drv, &hw);
	printf("Hardware architecture: %" PRIu32 ".%" PRIu32 ".%" PRIu32 "\n",
	       hw.version.arch_major_rev, hw.version.arch_minor_rev,
	       hw.version.arch_patch_rev);
	printf("Hardware revision: %" PRIu32 ".%" PRIu32 " (status %" PRIu32 ")\n",
	       hw.version.version_major, hw.version.version_minor, hw.version.version_status);
	printf("Product revision: %" PRIu32 "\n", hw.version.product_major);
	printf("Command stream version: %" PRIu32 "\n", hw.cfg.cmd_stream_version);
	printf("Custom DMA: %" PRIu32 "\n", hw.cfg.custom_dma);

	/* macs_per_cc is encoded as log2(MACs per cycle) by the hardware. */
	if (hw.cfg.macs_per_cc < 32U) {
		uint32_t macs = UINT32_C(1) << hw.cfg.macs_per_cc;

		printf("MACs per cycle: %" PRIu32 "\n", macs);
		if (macs != 256U) {
			printf("ERROR: Expected the E8's 256-MAC Ethos-U85 configuration.\n");
			ret = -EINVAL;
		}
	} else {
		printf("ERROR: Invalid MAC configuration: %" PRIu32 "\n", hw.cfg.macs_per_cc);
		ret = -EINVAL;
	}

	ethosu_release_driver(drv);
	if (ret == 0) {
		printf("Ethos-U85 driver communication OK (ID/configuration read; no inference).\n");
		return executorch_run_test();
	}

	return ret;
}
```

## src/executorch_test.cpp
```c
// Copyright 2026 Arm Limited and/or its affiliates.
// SPDX-License-Identifier: Apache-2.0
// Adapted from CMSIS-Executorch/src/app_main.cpp for the Zephyr application.

#include <array>
#include <cstdint>
#include <cstdio>
#include <cstring>
#include <memory>

#include <zephyr/linker/devicetree_regions.h>

#include <executorch/extension/data_loader/buffer_data_loader.h>
#include <executorch/runtime/core/evalue.h>
#include <executorch/runtime/core/exec_aten/exec_aten.h>
#include <executorch/runtime/core/memory_allocator.h>
#include <executorch/runtime/platform/runtime.h>

#include "arm_embedded_module.hpp"
#include "executorch_test.h"
#include "model_pte.h"

using arm::embedded::EmbeddedModule;
using executorch::aten::DimOrderType;
using executorch::aten::ScalarType;
using executorch::aten::SizesType;
using executorch::aten::Tensor;
using executorch::aten::TensorImpl;
using executorch::extension::BufferDataLoader;
using executorch::runtime::EValue;
using executorch::runtime::MemoryAllocator;

namespace {

// TinyCNN needs much less space than the original example's two 4 MiB pools.
constexpr size_t kMethodPoolSize = 128 * 1024;
constexpr size_t kTempPoolSize = 64 * 1024;

alignas(64) uint8_t g_method_pool[kMethodPoolSize];
// The NPU uses scratch directly. Keep it in system SRAM rather than CPU-local DTCM.
alignas(64) uint8_t g_temp_pool[kTempPoolSize]
    Z_GENERIC_SECTION(LINKER_DT_NODE_REGION_NAME(DT_NODELABEL(sram0)));

} // namespace

extern "C" int executorch_run_test(void)
{
  executorch::runtime::runtime_init();
  printf("ExecuTorch Ethos-U85-256 application: %lu byte model\n", model_pte_size);

  // Devicetree memory-region sections are NOLOAD and are not zeroed at boot.
  std::memset(g_temp_pool, 0, sizeof(g_temp_pool));

  EmbeddedModule module(
      model_pte, model_pte_size,
      std::make_unique<BufferDataLoader>(model_pte, model_pte_size),
      std::make_unique<MemoryAllocator>(kMethodPoolSize, g_method_pool),
      std::make_unique<MemoryAllocator>(kTempPoolSize, g_temp_pool));

  // Same deterministic image values as the CMSIS pack example. The supplied
  // U85 PTE exposes NCHW, whereas the original runner hard-codes NHWC.
  alignas(16) static float input_data[16 * 16 * 3];
  auto method_meta = module.method_meta("forward");
  if (!method_meta.ok()) {
    printf("Could not read forward metadata (err=%u)\nTest_result: FAIL\n",
           static_cast<unsigned>(method_meta.error()));
    return 1;
  }
  if (method_meta->num_inputs() != 1) {
    printf("forward expected one input\nTest_result: FAIL\n");
    return 1;
  }
  auto input_meta = method_meta->input_tensor_meta(0);
  if (!input_meta.ok() || input_meta->scalar_type() != ScalarType::Float ||
      input_meta->sizes().size() != 4 || input_meta->dim_order().size() != 4 ||
      input_meta->nbytes() != sizeof(input_data)) {
    printf("forward expected a rank-four RGB image with 768 floats\n"
           "Test_result: FAIL\n");
    return 1;
  }

  for (size_t i = 0; i < sizeof(input_data) / sizeof(input_data[0]); ++i) {
    input_data[i] = static_cast<float>(i % 32) / 32.0f - 0.5f;
  }
  std::array<SizesType, 4> sizes;
  std::array<DimOrderType, 4> dim_order;
  for (size_t i = 0; i < sizes.size(); ++i) {
    sizes[i] = input_meta->sizes()[i];
    dim_order[i] = input_meta->dim_order()[i];
  }
  printf("Input shape: [%ld, %ld, %ld, %ld]\n", static_cast<long>(sizes[0]),
         static_cast<long>(sizes[1]), static_cast<long>(sizes[2]),
         static_cast<long>(sizes[3]));
  TensorImpl input_impl(ScalarType::Float, sizes.size(), sizes.data(), input_data,
                        dim_order.data());
  Tensor input(&input_impl);

  auto outputs = module.forward(input);
  if (!outputs.ok()) {
    printf("forward failed (err=%u)\nTest_result: FAIL\n",
           static_cast<unsigned>(outputs.error()));
    return 1;
  }
  if (outputs->size() != 1 || !outputs->front().isTensor()) {
    printf("forward expected one output tensor\nTest_result: FAIL\n");
    return 1;
  }

  const EValue& out = outputs->front();
  Tensor tensor = out.toTensor();
  if (tensor.scalar_type() != ScalarType::Float || tensor.numel() != 10) {
    printf("forward expected ten float logits\nTest_result: FAIL\n");
    return 1;
  }

  printf("Output: %u element(s):", static_cast<unsigned>(tensor.numel()));
  const float* data = tensor.const_data_ptr<float>();
  for (size_t i = 0; i < tensor.numel(); ++i) {
    printf(" %.4f", static_cast<double>(data[i]));
  }
  printf("\nTest_result: PASS\n");
  fflush(stdout);
  return 0;
}
```

## src/executorch_test.h
```c
/* SPDX-License-Identifier: Apache-2.0 */
#pragma once

#ifdef __cplusplus
extern "C" {
#endif

int executorch_run_test(void);

#ifdef __cplusplus
}
#endif
```
